## buildroot-external/Config.in
```kconfig
# Buildroot External Tree — Top-level Kconfig

menu "Edge AI Camera System"

source "$BR2_EXTERNAL_EMBEDDED_AI_VISION_PATH/package/edge-ai-app/Config.in"
source "$BR2_EXTERNAL_EMBEDDED_AI_VISION_PATH/package/rknn-driver/Config.in"
source "$BR2_EXTERNAL_EMBEDDED_AI_VISION_PATH/package/camera-sensor/Config.in"

endmenu
```

## buildroot-external/configs/rk3399pro_edge_ai_defconfig
```kconfig
# Edge AI Camera — Buildroot Default Configuration
#
# 用法:
#   cd buildroot
#   make BR2_EXTERNAL=/path/to/embedded-ai-vision/buildroot-external rk3399pro_edge_ai_defconfig
#   make -j$(nproc)
#
# 产出:
#   output/images/
#     sdcard.img        — SD卡镜像 (可直接dd烧写到SD卡)
#     rootfs.tar        — rootfs压缩包
#     Image             — Linux内核镜像
#     rk3399pro-edge-ai-camera.dtb  — 设备树二进制

# ── 目标平台 ──────────────────────────────────────────────
BR2_aarch64=y
BR2_ARCH="aarch64"
BR2_ARM_CPU_HAS_NEON=y
BR2_ARM_CPU_HAS_VFPV4=y

# ── 交叉编译工具链 ────────────────────────────────────────
# 使用外部预编译工具链 (Linaro ARM GCC 10.3)
BR2_TOOLCHAIN_EXTERNAL=y
BR2_TOOLCHAIN_EXTERNAL_LINARO_AARCH64=y
BR2_TOOLCHAIN_EXTERNAL_GCC_10=y
BR2_TOOLCHAIN_EXTERNAL_HEADERS_4_19=y
BR2_TOOLCHAIN_EXTERNAL_CXX=y

# ── 系统配置 ──────────────────────────────────────────────
BR2_TARGET_GENERIC_HOSTNAME="rk3399pro-edge-ai"
BR2_TARGET_GENERIC_ISSUE="Edge AI Camera System"
BR2_ROOTFS_DEVICE_CREATION_DYNAMIC_EUDEV=y
BR2_ROOTFS_DEVICE_TABLE="system/device_table.txt"
BR2_ROOTFS_STATIC_DEVICE_TABLE="system/device_table_dev.txt"

# Init 系统: systemd
BR2_INIT_SYSTEMD=y
BR2_PACKAGE_SYSTEMD=y
BR2_PACKAGE_SYSTEMD_NETWORKD=y
BR2_PACKAGE_SYSTEMD_RESOLVED=y

# ── Linux 内核 ────────────────────────────────────────────
# 使用 Rockchip BSP 内核源码 (外部指定)
BR2_LINUX_KERNEL=y
BR2_LINUX_KERNEL_CUSTOM_GIT=y
BR2_LINUX_KERNEL_CUSTOM_REPO_URL="https://github.com/rockchip-linux/kernel.git"
BR2_LINUX_KERNEL_CUSTOM_REPO_VERSION="develop-4.19"
BR2_LINUX_KERNEL_DEFCONFIG="rk3399pro_linux"
BR2_LINUX_KERNEL_CONFIG_FRAGMENT_FILES="$(BR2_EXTERNAL)/board/rk3399pro-custom/linux.fragment"
BR2_LINUX_KERNEL_DTS_SUPPORT=y
BR2_LINUX_KERNEL_INTREE_DTS_NAME="rockchip/rk3399pro-edge-ai-camera"
BR2_LINUX_KERNEL_INSTALL_TARGET=y
BR2_LINUX_KERNEL_NEEDS_HOST_OPENSSL=y

# ── U-Boot ────────────────────────────────────────────────
BR2_TARGET_UBOOT=y
BR2_TARGET_UBOOT_BUILD_SYSTEM_KCONFIG=y
BR2_TARGET_UBOOT_CUSTOM_GIT=y
BR2_TARGET_UBOOT_CUSTOM_REPO_URL="https://github.com/rockchip-linux/u-boot.git"
BR2_TARGET_UBOOT_CUSTOM_REPO_VERSION="next-dev"
BR2_TARGET_UBOOT_BOARD_DEFCONFIG="rk3399pro"
BR2_TARGET_UBOOT_CONFIG_FRAGMENT_FILES="$(BR2_EXTERNAL)/board/rk3399pro-custom/uboot.fragment"
BR2_TARGET_UBOOT_NEEDS_DTC=y
BR2_TARGET_UBOOT_NEEDS_PYTHON3=y
BR2_TARGET_UBOOT_FORMAT_CUSTOM=y
BR2_TARGET_UBOOT_FORMAT_CUSTOM_NAME="u-boot.itb"
BR2_TARGET_UBOOT_SPL=y
BR2_TARGET_UBOOT_SPL_NAME="spl/u-boot-spl.bin"

# ── ARM Trusted Firmware ──────────────────────────────────
BR2_TARGET_ARM_TRUSTED_FIRMWARE=y
BR2_TARGET_ARM_TRUSTED_FIRMWARE_CUSTOM_GIT=y
BR2_TARGET_ARM_TRUSTED_FIRMWARE_CUSTOM_REPO_URL="https://github.com/rockchip-linux/rkbin.git"
BR2_TARGET_ARM_TRUSTED_FIRMWARE_PLATFORM="rk3399pro"

# ── 自定义软件包 ──────────────────────────────────────────
BR2_PACKAGE_RKNN_DRIVER=y
BR2_PACKAGE_EDGE_AI_APP=y
BR2_PACKAGE_CAMERA_SENSOR=y

# ── 必需依赖 ──────────────────────────────────────────────
BR2_PACKAGE_OPENCV4=y
BR2_PACKAGE_OPENCV4_LIB_IMGPROC=y
BR2_PACKAGE_OPENCV4_LIB_VIDEOIO=y
BR2_PACKAGE_OPENCV4_LIB_DNN=y
BR2_PACKAGE_EIGEN=y
BR2_PACKAGE_GSTREAMER1=y
BR2_PACKAGE_GST1_PLUGINS_BASE=y
BR2_PACKAGE_GST1_PLUGINS_GOOD=y
BR2_PACKAGE_GST1_PLUGINS_BAD=y
BR2_PACKAGE_GST1_PLUGINS_UGLY=y
BR2_PACKAGE_GST1_RTSP_SERVER=y
BR2_PACKAGE_MOSQUITTO=y
BR2_PACKAGE_GRPC=y
BR2_PACKAGE_PROTOBUF=y
BR2_PACKAGE_YAML_CPP=y
BR2_PACKAGE_SQLITE=y
BR2_PACKAGE_LIBCURL=y
BR2_PACKAGE_OPENSSL=y

# ── 网络工具 ──────────────────────────────────────────────
BR2_PACKAGE_ETHTOOL=y
BR2_PACKAGE_IPROUTE2=y
BR2_PACKAGE_IPTABLES=y
BR2_PACKAGE_DROPBEAR=y  # SSH server (轻量)

# ── 调试工具 (开发阶段) ───────────────────────────────────
BR2_PACKAGE_STRACE=y
BR2_PACKAGE_PROCPS_NG=y
BR2_PACKAGE_TOP=y
BR2_PACKAGE_HTOP=y
BR2_PACKAGE_IOSTAT=y

# ── 文件系统 ──────────────────────────────────────────────
# rootfs: ext4 (eMMC分区)
BR2_TARGET_ROOTFS_EXT2=y
BR2_TARGET_ROOTFS_EXT2_4=y
BR2_TARGET_ROOTFS_EXT2_LABEL="rootfs"
BR2_TARGET_ROOTFS_EXT2_SIZE="512M"

# ── SD 卡镜像生成 ─────────────────────────────────────────
BR2_PACKAGE_HOST_GENIMAGE=y
BR2_ROOTFS_POST_IMAGE_SCRIPT="$(BR2_EXTERNAL)/board/rk3399pro-custom/post-image.sh"
BR2_ROOTFS_POST_SCRIPT_ARGS=""

# ── 自定义 overlay (开机服务/配置文件) ────────────────────
BR2_ROOTFS_OVERLAY="$(BR2_EXTERNAL)/board/rk3399pro-custom/overlay"

# ── 输出压缩格式 ──────────────────────────────────────────
BR2_TARGET_ROOTFS_TAR=y
BR2_TARGET_ROOTFS_TAR_GZ=y
```

## buildroot-external/package/camera-sensor/Config.in
```kconfig
config BR2_PACKAGE_CAMERA_SENSOR
    bool "camera-sensor"
    depends on BR2_aarch64
    help
      IMX415 V4L2 sub-device driver and peripheral drivers
      (UART sensor, GPIO trigger) for Edge AI Camera.
```

## buildroot-external/package/edge-ai-app/Config.in
```kconfig
config BR2_PACKAGE_EDGE_AI_APP
    bool "edge-ai-app"
    depends on BR2_aarch64
    depends on BR2_PACKAGE_OPENCV4
    depends on BR2_PACKAGE_MOSQUITTO
    select BR2_PACKAGE_GSTREAMER1
    select BR2_PACKAGE_GST1_PLUGINS_BASE
    select BR2_PACKAGE_GST1_PLUGINS_BAD
    select BR2_PACKAGE_GST1_RTSP_SERVER
    help
      Edge AI Camera inference application for RK3399Pro.
      Multi-threaded pipeline: V4L2 capture → NPU inference →
      SORT tracking → MQTT publish + Video encoding (H.264/H.265
      via GStreamer + Rockchip MPP) + RTSP live streaming.
      Managed by systemd service edge-ai-camera.
```

## buildroot-external/package/rknn-driver/Config.in
```kconfig
config BR2_PACKAGE_RKNN_DRIVER
    bool "rknn-driver"
    depends on BR2_aarch64
    help
      RK3399Pro NPU kernel driver (RK1808).
      Rockchip Neural Network Processing Unit driver.
```

## kernel/drivers/camera/Kconfig
```kconfig
# Edge AI Camera Drivers — Kconfig

menu "Edge AI Camera Drivers"

config EDGE_AI_IMX415
    tristate "Sony IMX415 V4L2 Camera Sensor Driver"
    depends on I2C && VIDEO_V4L2 && VIDEO_V4L2_SUBDEV_API
    select REGMAP_I2C
    select V4L2_FWNODE
    help
      V4L2 sub-device driver for Sony IMX415 1/2.8" CMOS image sensor.
      Supports 1920×1080 @30fps RAW10 output via MIPI CSI-2 4-lane.

      To compile this driver as a module, choose M here:
      the module will be called imx415_v4l2.

config EDGE_AI_UART_SENSOR
    tristate "UART Sensor Character Device Driver"
    depends on SERIAL_DEV_BUS
    help
      Character device driver that wraps a UART port for sensor data
      acquisition (GPS NMEA / environmental sensors). Provides
      /dev/uart_sensor with read/write/poll/ioctl interface and
      sysfs statistics under /sys/class/edge-sensor/.

      To compile this driver as a module, choose M here:
      the module will be called uart_sensor.

config EDGE_AI_GPIO_TRIGGER
    tristate "GPIO Trigger Driver"
    depends on GPIOLIB
    help
      GPIO interrupt driver that exposes trigger events via
      /dev/gpio_trigger. Supports multiple GPIO pins with
      configurable debounce. Uses tasklet for bottom-half
      interrupt processing.

      To compile this driver as a module, choose M here:
      the module will be called gpio_trigger.

endmenu
```

## kernel/drivers/npu/Kconfig
```kconfig
# RK3399Pro NPU Driver — Kconfig/Makefile

config EDGE_AI_NPU
	tristate "RK3399Pro NPU Driver"
	depends on ARCH_ROCKCHIP || COMPILE_TEST
	select DMA_CMA
	select DMA_SHARED_BUFFER
	help
	  Rockchip RK3399Pro Neural Processing Unit (NPU) driver.
	  This enables the /dev/rknpu misc device for AI inference
	  acceleration on the RK1808 NPU IP core.

	  The NPU provides:
	    - 3.0 TOPS INT8 peak performance
	    - 1920 MAC units @ 800MHz
	    - 256KB on-chip SRAM
	    - Support for CNN, RNN, LSTM networks

	  To compile this driver as a module, choose M here:
	  the module will be called rknpu.

	  If unsure, say Y.
```

## kernel/drivers/peripheral/Kconfig
```kconfig
# Edge AI Peripheral Drivers — Kconfig

menu "Edge AI Peripheral Drivers"

config EDGE_AI_UART_SENSOR
    tristate "UART Sensor Character Device Driver"
    depends on SERIAL_DEV_BUS
    help
      Character device driver that wraps a UART port for sensor data
      acquisition (GPS NMEA / environmental sensors). Provides
      /dev/uart_sensor with read/write/poll/ioctl interface and
      sysfs statistics under /sys/class/edge-sensor/.

      To compile this driver as a module, choose M here:
      the module will be called uart_sensor.

config EDGE_AI_GPIO_TRIGGER
    tristate "GPIO Trigger Driver"
    depends on GPIOLIB
    help
      GPIO interrupt driver that exposes trigger events via
      /dev/gpio_trigger. Supports multiple GPIO pins with
      configurable debounce. Uses tasklet for bottom-half
      interrupt processing.

      To compile this driver as a module, choose M here:
      the module will be called gpio_trigger.

config EDGE_AI_SPI_SENSOR
    tristate "Edge AI SPI Sensor Driver"
    depends on SPI
    help
      SPI sensor character device driver for RK3399Pro Edge AI Camera.
      Provides /dev/spi_sensor for userspace SPI access with
      read/write/ioctl/poll interface and sysfs statistics
      under /sys/class/edge-sensor/.

      Supports full-duplex transfer, configurable speed/mode/bits,
      and transfer statistics.

      To compile this driver as a module, choose M here:
      the module will be called spi_sensor.

endmenu
```
